## main/Kconfig.projbuild
```kconfig
menu "DollyBot"
config DOLLY_AP_SSID
    string "Wi-Fi AP name"
    default "DollyBot"
config DOLLY_AP_PASSWORD
    string "Wi-Fi AP password (8-63 ASCII characters)"
    default "dollybot123"
config DOLLY_AP_CHANNEL
    int "Wi-Fi channel"
    range 1 11
    default 6
endmenu
```

## sdkconfig.defaults
```kconfig
CONFIG_IDF_TARGET="esp32"
CONFIG_ESPTOOLPY_FLASHSIZE_2MB=y
CONFIG_HTTPD_WS_SUPPORT=y
CONFIG_HTTPD_MAX_REQ_HDR_LEN=1024
CONFIG_ESP_MAIN_TASK_STACK_SIZE=6144
CONFIG_COMPILER_OPTIMIZATION_SIZE=y
```
